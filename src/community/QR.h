// ============================================================
// QR.h - Codigos QR integrados para COCODRILO OS
//
// No requiere librerias externas. Los codigos estan precalculados y
// almacenados en PROGMEM para ahorrar RAM.
//
// QR Wi-Fi:
//   Red abierta "COCODRILO-SETUP"
// QR Tutorial:
//   URL: https://youtu.be/fe_hc8LxM10
//
// Cuando publiques el tutorial definitivo, hay que regenerar la matriz
// QR_TUTORIAL_DATA con la URL nueva.
// ============================================================
#ifndef COCODRILO_QR_H
#define COCODRILO_QR_H

#include <Arduino.h>
#include <pgmspace.h>
#include <TFT_eSPI.h>

namespace QR {

static const char* const WIFI_SSID = "COCODRILO-SETUP";
static const char* const URL_TUTORIAL_GALERIA = "https://youtu.be/fe_hc8LxM10";

static const uint8_t QR_WIFI_SIZE = 29;
static const uint8_t QR_WIFI_DATA[] PROGMEM = {
  0xFE, 0xA7, 0x33, 0xFC, 0x12, 0x88, 0x10, 0x6E, 0xB3, 0x12, 0xBB, 0x74, 0xB3, 0x55, 0xDB, 0xA5,
  0x1B, 0x2E, 0xC1, 0x77, 0x51, 0x07, 0xFA, 0xAA, 0xAF, 0xE0, 0x0B, 0x81, 0x00, 0xA3, 0x55, 0xD9,
  0x2E, 0xCA, 0x86, 0x79, 0x0A, 0xB3, 0xA5, 0x8A, 0x99, 0x77, 0x7C, 0x1D, 0xAB, 0x6A, 0xE0, 0x8C,
  0x5F, 0x27, 0x93, 0x4F, 0x85, 0x53, 0x2B, 0x08, 0xA6, 0xCA, 0x7F, 0x3C, 0x5B, 0x30, 0x60, 0x49,
  0x6A, 0x3C, 0xEB, 0xCD, 0xFA, 0x19, 0xE6, 0x7C, 0x3D, 0x22, 0xE4, 0xF8, 0x80, 0x5F, 0x84, 0x5B,
  0xFA, 0xA7, 0x6B, 0x30, 0x42, 0x87, 0x1A, 0xBA, 0x75, 0x5F, 0xDD, 0xD3, 0x45, 0xCF, 0x6E, 0xBF,
  0xD6, 0x37, 0x04, 0xB9, 0x07, 0x8F, 0xED, 0x34, 0xC4, 0x80
};

// QR Tutorial (galeria) - apunta a https://youtu.be/fe_hc8LxM10
// Regenerado: version 2, EC nivel L, 25x25 modulos.
static const uint8_t QR_TUTORIAL_SIZE = 25;
static const uint8_t QR_TUTORIAL_DATA[] PROGMEM = {
  0xFE, 0xF6, 0x3F, 0xC1, 0x0C, 0x50, 0x6E, 0x95, 0x0B, 0xB7, 0x47, 0xB5, 0xDB, 0xA3, 0xA2, 0xEC,
  0x12, 0xD1, 0x07, 0xFA, 0xAA, 0xFE, 0x01, 0x99, 0x00, 0xDA, 0x47, 0xA0, 0x94, 0x5E, 0x8F, 0xA2,
  0xF5, 0x47, 0x2B, 0x93, 0x71, 0xF3, 0x77, 0x1A, 0x0D, 0xAB, 0xDE, 0x4B, 0x6B, 0x97, 0xBF, 0x1B,
  0x86, 0xED, 0xAE, 0x0C, 0xFB, 0x00, 0x78, 0x45, 0xBF, 0x8E, 0xAA, 0x30, 0x49, 0x91, 0x1B, 0xA9,
  0x1F, 0x95, 0xD5, 0xAF, 0x0E, 0xE8, 0xE8, 0x3F, 0x05, 0x22, 0x77, 0xFE, 0xEC, 0xE4, 0x80
};


static const char* const URL_ACTUALIZACIONES =
    "https://backmeteor4090quintana.github.io/arcade-console-updates/";

static const uint8_t QR_ACTUALIZACIONES_SIZE = 37;
static const uint8_t QR_ACTUALIZACIONES_DATA[] PROGMEM = {
  0xFE, 0xE3, 0x9C, 0x7B, 0xFC, 0x13, 0x30, 0x8E, 0x10, 0x6E, 0x95, 0x71, 0x2E, 0xBB, 0x75, 0x5E,
  0x50, 0xF5, 0xDB, 0xA8, 0x06, 0x17, 0xAE, 0xC1, 0x67, 0x68, 0x21, 0x07, 0xFA, 0xAA, 0xAA, 0xAF,
  0xE0, 0x13, 0x70, 0xB2, 0x00, 0x8B, 0xC5, 0x88, 0x0F, 0xCC, 0xE6, 0x43, 0xB5, 0xE4, 0x92, 0xB4,
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  0x65, 0x89, 0x04, 0x94, 0x8C, 0x25, 0x6F, 0xEC, 0x55, 0xE3, 0x33, 0x80
};


static const char* const URL_CONVERSOR_MJPEG =
    "https://backmeteor4090quintana.github.io/arcade-console-updates/tools/mjpeg/";

static const uint8_t QR_CONVERSOR_MJPEG_SIZE = 37;
static const uint8_t QR_CONVERSOR_MJPEG_DATA[] PROGMEM = {
  0xFE, 0x64, 0xFA, 0x63, 0xFC, 0x15, 0xD0, 0x41, 0x10, 0x6E, 0xB3, 0x2F, 0xCC, 0xBB, 0x75, 0xC5,
  0xAB, 0x95, 0xDB, 0xA6, 0x07, 0x90, 0xAE, 0xC1, 0x17, 0x65, 0x11, 0x07, 0xFA, 0xAA, 0xAA, 0xAF,
  0xE0, 0x1D, 0x6C, 0x01, 0x00, 0x82, 0x94, 0x92, 0xFE, 0x77, 0x27, 0xC7, 0xEB, 0xAD, 0x94, 0xF9,
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  0x86, 0x07, 0x04, 0x63, 0x63, 0x19, 0x9F, 0xED, 0x68, 0x92, 0xF4, 0x80
};

static inline bool modulo(const uint8_t* datos, uint8_t tam, uint8_t x, uint8_t y) {
  const uint16_t indice = (uint16_t)y * tam + x;
  const uint8_t valor = pgm_read_byte(datos + (indice >> 3));
  return ((valor >> (7 - (indice & 7))) & 1U) != 0;
}

template <typename Pantalla>
void dibujarMatriz(Pantalla &destino,
                   const uint8_t* datos,
                   uint8_t tam,
                   int centroX,
                   int centroY,
                   int maximoPx,
                   uint16_t colorOscuro = TFT_BLACK,
                   uint16_t colorClaro = TFT_WHITE) {
  const int margen = 4;  // zona silenciosa obligatoria del QR
  const int modulosTotales = tam + margen * 2;
  int escala = maximoPx / modulosTotales;
  if (escala < 1) escala = 1;

  const int lado = modulosTotales * escala;
  const int origenX = centroX - lado / 2;
  const int origenY = centroY - lado / 2;

  destino.fillRect(origenX, origenY, lado, lado, colorClaro);

  for (uint8_t y = 0; y < tam; ++y) {
    for (uint8_t x = 0; x < tam; ++x) {
      if (modulo(datos, tam, x, y)) {
        destino.fillRect(origenX + (x + margen) * escala,
                         origenY + (y + margen) * escala,
                         escala, escala, colorOscuro);
      }
    }
  }
}

template <typename Pantalla>
void dibujarWiFi(Pantalla &destino, int centroX, int centroY, int maximoPx) {
  dibujarMatriz(destino, QR_WIFI_DATA, QR_WIFI_SIZE,
                centroX, centroY, maximoPx);
}

template <typename Pantalla>
void dibujarTutorialGaleria(Pantalla &destino,
                            int centroX, int centroY, int maximoPx) {
  dibujarMatriz(destino, QR_TUTORIAL_DATA, QR_TUTORIAL_SIZE,
                centroX, centroY, maximoPx);
}


template <typename Pantalla>
void dibujarActualizaciones(Pantalla &destino,
                            int centroX, int centroY, int maximoPx) {
  dibujarMatriz(destino, QR_ACTUALIZACIONES_DATA, QR_ACTUALIZACIONES_SIZE,
                centroX, centroY, maximoPx);
}


template <typename Pantalla>
void dibujarConversorMJPEG(Pantalla &destino,
                           int centroX, int centroY, int maximoPx) {
  dibujarMatriz(destino,
                QR_CONVERSOR_MJPEG_DATA,
                QR_CONVERSOR_MJPEG_SIZE,
                centroX, centroY, maximoPx);
}

} // namespace QR

#endif
